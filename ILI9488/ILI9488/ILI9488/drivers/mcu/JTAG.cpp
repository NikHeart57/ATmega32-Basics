#include "JTAG.h"

//////////////////////////////////////////////////////////////////////////
//  ПРОВЕРКА ПОДДЕРЖКИ МИКРОКОНТРОЛЛЕРА (ATmega32 ONLY)
//////////////////////////////////////////////////////////////////////////

#ifndef __AVR_ATmega32__
	#error "JTAG driver requires ATmega32 MCU! Check your target device."
#endif

//////////////////////////////////////////////////////////////////////////
//	Функции инициализации JTAG
//////////////////////////////////////////////////////////////////////////

/**
 * @brief Управление состоянием JTAG (включение/отключение)
 * @param state Требуемое состояние JTAG
 * @note Реализация ограничена только управлением состоянием, без поддержки других функций JTAG
 * @warning Для изменения состояния требуется двойная запись в регистр MCUCSR
 */
uint8_t JTAG_Init(JTAG_State state)
{
	switch(state) 
	{
		// Стандартное отключение JTAG
		case JTAG_DISABLED:
		MCUCSR = (1 << JTD);
		MCUCSR = (1 << JTD);
		// Проверяем что JTAG действительно отключился
		if(MCUCSR & (1 << JTD)) 
		{
			return 1; // Успех (бит установлен)
		}
		return 0; // Ошибка отключения
		break;
		
		case JTAG_ENABLED:
		// Включение JTAG (сброс бита JTD)
		MCUCSR &= ~(1 << JTD);
		MCUCSR &= ~(1 << JTD);
		// Проверяем что JTAG действительно включился
		if(!(MCUCSR & (1 << JTD))) 
		{
			return 1; // Успех (бит сброшен)
		}
		return 0; // Ошибка включения
		break;
	}
	
	return 0; // Некорректный режим
}

/**
 * @brief Проверка текущего состояния JTAG
 * @note Функция только проверяет состояние бита JTD, не предоставляя других возможностей диагностики
 */
uint8_t JTAG_IsWorking(void)
{
	return !(MCUCSR & (1 << JTD));
}