/* 
 * В этом примере показано как настроить АЦП у микроконтроллера AtMega32
 * Пин сравнения PA0. Если на PA0 напряжение меньше 1В то зажгется желтая лампа (PC2), 
 * если в диапазоне от 1 до 1,5 то зажгется зеленая (PC3), если более 1,5 то зажгется красная (PC4).
 * Для наглядности значение регистра ADC выводится на пины ADCL - PD0..7, ADCH - PC0..1.
 * В работе используется внутненний ИОН МК.
 * Пины AREF и AVCC конденсаторами связаны с землей, AVCC подключен к VCC через индукцию.
 * AREF к земле не подключать !
 */

#define F_CPU 7372800
#include <avr/io.h>
#include <util/delay.h>
#include <stdio.h>
#include <stdlib.h>

void setup()
{
	DDRD = 0xff;         // Все выходы (1)
	DDRC = 0xff;         // Все выходы (1)
	DDRA = 0b00000000;   // Все входы  (0)
	
	ADCSRA |= (1 << ADEN);                                // Разрешаем работу АЦП (1)
	ADCSRA |= (1 << ADSC);                                // Запуск АЦП (1)
	ADCSRA |= (1 << ADPS2)|(1 << ADPS1)|(1 << ADPS0);     // Задаю делитель N для определения частоты дискретизации f_ацп = f_цпу / N;
	                                                      // при ADPS0..2 = 111       => f_ацп = 7372800 / 128 = 57600Гц
	ADMUX  |= (1 << REFS1)|(1 << REFS0);                  // Задаю ИОН, REFS0..1 = 11 => внутренний ИОН, U_ион = 2,56В
	ADMUX  |= (0 << ADLAR);                               // Правосторонее выравнивание ADLAR = 0; ADCH, ADCL
	ADMUX  |= (0 << MUX4)|(0 << MUX3)|(0 << MUX2)|(0 << MUX1)|(0 << MUX0);  // Выбор пина АЦП; MX0..4 = 00000 => ADC0(PA0);
}


int main(void)
{
	setup();
	
	while (1)
	{
		_delay_ms(50);
		if (ADCSRA & (1 << ADIF))        // Если флаг ADIF = 0 (т.е.ADCSRA&(1<<ADIF)=true) значит преобразование выполнилось
		{
			PORTD = ADCL;                // Вывод состояния регистра ADC в порты, чтобы наглядно видеть как работает АЦП
			PORTC = ADCH;                //
			ADCSRA |= (1 << ADIF);       // Установка флага ADIF, чтобы позволить дальнейшую работу АЦП
			ADCSRA |= (1 << ADSC);       // Запуск АЦП
		}

		if (ADC < 400)                                 // Если U_in < 1В (ADC < 400) - загорится желтая лампа (PC2)
		{
			PORTC |= (1 << PC2)|(0 << PC3)|(0 << PC4);
		}
		else if	(ADC >= 400 && ADC <= 600)	           // Если 1В (ADC > 400) >= U_in <= 1.5В (ADC < 600) - загорится зеленая лампа (PC3)
		{
			PORTC |= (0 << PC2)|(1 << PC3)|(0 << PC4);
		}
		else if (ADC >= 600)                           // Если U_in > 1.5В (ADC > 600) - загорится красная лампа (PC4)
		{
			PORTC |= (0 << PC2)|(0 << PC3)|(1 << PC4);
		}
	}
}

